## main/Kconfig.projbuild
```kconfig
menu "Mosaico Translator"
    config MOSAICO_USB_HIGH_SPEED
        bool
        default y if IDF_TARGET_ESP32S31

    config TRANSLATOR_AEC_REF_DELAY_MS
        int "DAC to microphone reference delay (ms)"
        range 0 100
        default 0
        help
            Additional analog/acoustic delay after completed I2S TX samples.
            Mic and actual DAC PCM are paired on their DMA sample timestamps.
            Calibrate this only from a simultaneous raw Mic / Ref recording.

    config TRANSLATOR_WIFI_SSID
        string "Wi-Fi SSID"
        default ""
    config TRANSLATOR_WIFI_PASSWORD
        string "Wi-Fi password"
        default ""
    config TRANSLATOR_CUSTOMER_ID
        string "Agora REST customer ID"
        default ""
    config TRANSLATOR_CUSTOMER_SECRET
        string "Agora REST customer secret"
        default ""
    config TRANSLATOR_API_BASE
        string "V2V API base URL"
        default "https://api-ap-southeast-1.agora.io"
    config TRANSLATOR_WHIP_BASE
        string "Agora duplex WHIP base URL"
        default "https://ap-webrtc-whip.ap.sd-rtn.com"
    config TRANSLATOR_APP_ID
        string "Agora App ID"
        default ""
    config TRANSLATOR_APP_CERT
        string "Agora App Certificate (leave empty if disabled)"
        default ""
    config TRANSLATOR_VOICE_ID
        string "English TTS voice ID"
        default "male-qn-qingse"
    config TRANSLATOR_AUTO_START
        bool "Start translation automatically when USB, Wi-Fi and time are ready"
        default n
endmenu
```

## sdkconfig.defaults
```kconfig
CONFIG_IDF_TARGET="esp32s31"
CONFIG_IDF_EXPERIMENTAL_FEATURES=y
CONFIG_COMPILER_OPTIMIZATION_PERF=y
CONFIG_FREERTOS_HZ=1000
CONFIG_ESP_MAIN_TASK_STACK_SIZE=8192
CONFIG_ESP_CONSOLE_UART_DEFAULT=y
CONFIG_ESP_CONSOLE_SECONDARY_NONE=y
# CONFIG_ESP_CONSOLE_USB_SERIAL_JTAG is not set
# CONFIG_USJ_ENABLE_USB_SERIAL_JTAG is not set
CONFIG_SPIRAM=y
CONFIG_SPIRAM_MODE_OCT=y
CONFIG_SPIRAM_SPEED_250M=y
CONFIG_SPIRAM_XIP_FROM_PSRAM=y
CONFIG_SPIRAM_MEMTEST=n
CONFIG_SPIRAM_MALLOC_RESERVE_INTERNAL=32768
CONFIG_SPIRAM_ALLOW_BSS_SEG_EXTERNAL_MEMORY=y
CONFIG_SPIRAM_ALLOW_NOINIT_SEG_EXTERNAL_MEMORY=y
CONFIG_SPIRAM_MALLOC_ALWAYSINTERNAL=256
CONFIG_SPIRAM_TRY_ALLOCATE_WIFI_LWIP=y
CONFIG_MBEDTLS_EXTERNAL_MEM_ALLOC=y
CONFIG_ESPTOOLPY_FLASHSIZE_16MB=y
CONFIG_PARTITION_TABLE_CUSTOM=y
CONFIG_PARTITION_TABLE_CUSTOM_FILENAME="partitions.csv"
CONFIG_LWIP_SNTP_MAX_SERVERS=2
CONFIG_LWIP_UDP_RECVMBOX_SIZE=32
CONFIG_MBEDTLS_SSL_PROTO_DTLS=y
CONFIG_MBEDTLS_SSL_DTLS_SRTP=y
CONFIG_MBEDTLS_X509_CREATE_C=y
CONFIG_MBEDTLS_X509_CRT_WRITE_C=y
CONFIG_MBEDTLS_CERTIFICATE_BUNDLE=y
CONFIG_AUDIO_ENCODER_OPUS_SUPPORT=y
CONFIG_AUDIO_DECODER_OPUS_SUPPORT=y
CONFIG_ESP_CAPTURE_ENABLE_AUDIO=y
# CONFIG_ESP_CAPTURE_ENABLE_VIDEO is not set
CONFIG_CODEC_ES8311_SUPPORT=y
CONFIG_BSP_DISPLAY_ENABLE=y
CONFIG_BSP_DISPLAY_LVGL_ENABLE=y
CONFIG_LV_FONT_MONTSERRAT_20=y
CONFIG_LV_FONT_MONTSERRAT_28=y
CONFIG_LV_FONT_MONTSERRAT_40=y
CONFIG_LV_FONT_SOURCE_HAN_SANS_SC_16_CJK=y
CONFIG_MOSAICO_USB_HIGH_SPEED=y
CONFIG_USB_DEVICE_UAC_AS_PART=y
CONFIG_UAC_SPEAKER_CHANNEL_NUM=2
CONFIG_UAC_MIC_CHANNEL_NUM=1
CONFIG_UAC_SAMPLE_RATE=48000
CONFIG_UAC_BIT_RESOLUTION_16=y
CONFIG_UAC_SUPPORT_MACOS=y
CONFIG_UAC_SPK_INTERVAL_MS=10
CONFIG_UAC_SPK_TASK_PRIORITY=6
CONFIG_UAC_TINYUSB_TASK_PRIORITY=7
CONFIG_UAC_MIC_TASK_PRIORITY=5
```
